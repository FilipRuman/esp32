## HTTP/main/Kconfig.projbuild
```kconfig
menu "->WIFI connection"

    config WIFI_SSID
        string "SSID"
        default "myssid"
        help
            SSID (network name) for the example to connect to.

    config WIFI_PASSWORD
        string "Password"
        default "mypassword"
        help
            WiFi password (WPA or WPA2) for the example to use.
            Can be left blank if the network has no security set.
endmenu
```
